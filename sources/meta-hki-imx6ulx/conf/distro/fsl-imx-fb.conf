## sources/meta-hki-imx6ulx/conf/distro/fsl-imx-fb.conf
```bitbake
# i.MX DISTRO for the FrameBuffer graphical backend.

include conf/distro/include/hki-imx-base.inc
include conf/distro/include/hki-imx-preferred-evn.inc

DISTRO = "fsl-imx-fb"

# Remove conflicting backends.
DISTRO_FEATURES_remove = "x11 wayland directfb "
```

## sources/meta-hki-imx6ulx/conf/distro/include/hki-imx-preferred-evn.inc
```bitbake
# Use i.MX Kernel, U-Boot and Gstreamer 1.0 providers
PREFERRED_PROVIDER_u-boot_mx6ul = "u-boot-mys6ulx"
PREFERRED_PROVIDER_u-boot_mx6ull = "u-boot-mys6ulx"

PREFERRED_PROVIDER_virtual/bootloader_mx6ul = "u-boot-mys6ulx"
PREFERRED_PROVIDER_virtual/bootloader_mx6ull = "u-boot-mys6ulx"

PREFERRED_PROVIDER_virtual/kernel_mx6ul = "linux-mys6ulx"
PREFERRED_PROVIDER_virtual/kernel_mx6ull = "linux-mys6ulx"

MACHINE_GSTREAMER_1_0_PLUGIN_mx6ul = "imx-gst1.0-plugin"
MACHINE_GSTREAMER_1_0_PLUGIN_mx6ull = "imx-gst1.0-plugin"

# Extra audio support
# Add back some setting for i.MX6ul & i.MX7d which have not been upstreamed
MACHINE_EXTRA_RRECOMMENDS_append_mx6ul = " ${@bb.utils.contains('DISTRO_FEATURES', 'alsa', 'imx-alsa-plugins', '', d)}"

# Default toolchains used in testing i.MX BSPs
DEFAULTTUNE_mx6ul = "cortexa7hf-neon"

# Enable the kenrel loadable module as default
#USE_GPU_VIV_MODULE = "1"

PREFERRED_VERSION_linux-libc-headers = "4.1"

# Use systemd as default init manager - comment out for now
#VIRTUAL-RUNTIME_init_manager = "systemd"
#PREFERRED_PROVIDER_udev = "systemd"
#PREFERRED_PROVIDER_udev-utils = "systemd"
#DISTRO_FEATURES_BACKFILL_CONSIDERED = "sysvinit"
#IMX_DEFAULT_DISTRO_FEATURES += " systemd"

GCCVERSION = "5.3.0"
```

## sources/meta-hki-imx6ulx/conf/layer.conf
```bitbake
# We have a conf and classes directory, add to BBPATH
BBPATH .= ":${LAYERDIR}"

# We have recipes-* directories, add to BBFILES
BBFILES += "${LAYERDIR}/recipes-*/*/*.bb \
	${LAYERDIR}/recipes-*/*/*.bbappend"

BBFILE_COLLECTIONS += "hki-imx6ulx"
BBFILE_PATTERN_hki-imx6ulx = "^${LAYERDIR}/"
BBFILE_PRIORITY_hki-imx6ulx = "8"
```

## sources/meta-hki-imx6ulx/conf/machine/agd-y6ull14x14.conf
```bitbake
#@TYPE: Machine
#@NAME: HKI AGD-Y6ULL 14x14 board
#@SOC: i.MX6ULL
#@DESCRIPTION: Machine configuration for HKI AGD6ULL 14x14 board
#@MAINTAINER: Lauren Post <lauren.post@nxp.com>

include conf/machine/include/mys6ulx-base.inc
include conf/machine/include/tune-cortexa7.inc
include conf/machine/include/mys6ulx-common.inc

MACHINE_FIRMWARE_append = " firmware-brcm43362"

SOC_FAMILY = "mx6ul:mx6ull"

KERNEL_DEVICETREE = "hki-y6ull-14x14.dtb \
    myd-y6ull-emmc.dtb \
"

UBOOT_CONFIG ??= "emmc sd"
UBOOT_CONFIG[emmc] = "myd_y6ull_14x14_emmc_config,emmc"
UBOOT_CONFIG[sd] = "myd_y6ull_14x14_emmc_config,sd"
UBOOT_CONFIG[mfgtool] = "mx6ull_14x14_evk_config"
```

## sources/meta-hki-imx6ulx/conf/machine/include/mys6ulx-base.inc
```bitbake
# Provides the i.MX common settings

include conf/machine/include/fsl-default-settings.inc
include conf/machine/include/fsl-default-versions.inc

include conf/machine/include/soc-family.inc

# Set specific make target and binary suffix
PREFERRED_PROVIDER_u-boot ??= "u-boot-mys6ulx"
PREFERRED_PROVIDER_virtual/bootloader ??= "u-boot-mys6ulx"

UBOOT_MAKE_TARGET ?= "u-boot.imx"

UBOOT_SUFFIX ?= "imx"

UBOOT_ENTRYPOINT_mx6ul  = "0x10008000"

PREFERRED_PROVIDER_virtual/xserver = "xserver-xorg"
XSERVER_DRIVER = "xf86-video-fbdev"
XSERVER_DRIVER_mx6 = "xf86-video-imxfb-vivante"
XSERVER_DRIVER_vf = "xf86-video-modesetting"
XSERVER = "xserver-xorg \
           xf86-input-evdev \
           ${XSERVER_DRIVER}"

# Ship kernel modules
MACHINE_EXTRA_RRECOMMENDS = "kernel-modules"

# Tunes for hard/soft float-point selection. Note that we allow building for
# thumb support giving distros the chance to enable thumb by setting
# ARM_INSTRUCTION_SET = "thumb"
#
# handled by software
# DEFAULTTUNE_mx6 ?= "cortexa9t-neon"
# handled by hardware
DEFAULTTUNE_mx6 ?= "cortexa9thf-neon"
DEFAULTTUNE_mx6ul ?= "cortexa7thf-neon"

# Sub-architecture support
MACHINE_SOCARCH_SUFFIX ?= ""
MACHINE_SOCARCH_SUFFIX_mx6ul = "-mx6ul"
MACHINE_SOCARCH_SUFFIX_mx6ull = "-mx6ull"

MACHINE_ARCH_FILTER = "virtual/kernel"
MACHINE_SOCARCH_FILTER_append_mx6 = " imx-vpu libimxvpuapi imx-codec imx-vpuwrap imx-parser"
MACHINE_SOCARCH_FILTER_append_mx6 = " virtual/libopenvg virtual/libgles1 virtual/libgles2 virtual/egl virtual/mesa virtual/libgl virtual/libg2d"
MACHINE_SOCARCH_FILTER_append_mx6ul = " imx-codec imx-parser"
MACHINE_SOCARCH_FILTER_append_mx7 =  " imx-codec imx-parser"

INHERIT += "fsl-dynamic-packagearch"

SIGGEN_EXCLUDE_SAFE_RECIPE_DEPS_append_mx6 = " \
    imx-gpu-viv->kernel-module-imx-gpu-viv \
    libimxvpuapi->imx-vpu \
    imx-vpuwrap->imx-vpu \
    imx-codec->imx-vpu \
    imx-test->imx-vpu \
"

# Firmware
MACHINE_FIRMWARE ?= ""
MACHINE_FIRMWARE_append_mx6ul = ""
MACHINE_FIRMWARE_append_mx6ull = ""
MACHINE_FIRMWARE_append_mx6q = " firmware-imx-vpu-imx6q"
MACHINE_FIRMWARE_append_mx6dl = " firmware-imx-vpu-imx6d firmware-imx-epdc"

MACHINE_EXTRA_RRECOMMENDS += "${MACHINE_FIRMWARE}"

# Extra audio support
# FIXME: Add support for ALL SoC families
MACHINE_EXTRA_RRECOMMENDS_append_mx6 = " ${@bb.utils.contains('DISTRO_FEATURES', 'alsa', 'imx-alsa-plugins', '', d)}"

# Extra udev rules
MACHINE_EXTRA_RRECOMMENDS += "udev-rules-imx"

# GStreamer 1.0 plugins
MACHINE_GSTREAMER_1_0_PLUGIN ?= ""

# Determines if the SoC has support for Vivante kernel driver
SOC_HAS_VIVANTE_KERNEL_DRIVER_SUPPORT       = "0"

# Handle Vivante kernel driver setting:
#   0 - machine does not have Vivante GPU driver support
#   1 - machine has Vivante GPU driver support
MACHINE_HAS_VIVANTE_KERNEL_DRIVER_SUPPORT ?= "${SOC_HAS_VIVANTE_KERNEL_DRIVER_SUPPORT}"

# mx6 GPU libraries
PREFERRED_PROVIDER_virtual/egl_mx6ul ?= "mesa"
PREFERRED_PROVIDER_virtual/libgles1_mx6ul ?= "mesa"
PREFERRED_PROVIDER_virtual/libgles2_mx6ul ?= "mesa"
PREFERRED_PROVIDER_virtual/libgl_mx6ul ?= "mesa"
PREFERRED_PROVIDER_virtual/libg2d_mx6ul = ""

# Handle default kernel
IMX_DEFAULT_KERNEL = "linux-mys6ulx"
IMX_DEFAULT_KERNEL_mx6ul = "linux-mys6ulx"
IMX_DEFAULT_KERNEL_mx6ull = "linux-mys6ulx"

PREFERRED_PROVIDER_virtual/kernel ??= "${IMX_DEFAULT_KERNEL}"

SOC_DEFAULT_IMAGE_FSTYPES = "sdcard.gz ext3 ubi ubifs"

SDCARD_ROOTFS ?= "${DEPLOY_DIR_IMAGE}/${IMAGE_NAME}.rootfs.ext4"
IMAGE_FSTYPES ?= "${SOC_DEFAULT_IMAGE_FSTYPES}"

SERIAL_CONSOLE = "115200 ttymxc0"

KERNEL_IMAGETYPE = "zImage"

MACHINE_FEATURES = "apm usbgadget usbhost vfat alsa touchscreen"

# Add the ability to specify _imx machines
MACHINEOVERRIDES =. "imx:"
```
